// This file was generated from a template. Edit it to match your keyboard.
// See https://zmk.dev/docs/development/hardware-integration/new-shield for more
// instructions.

#include "icarus.dtsi"

&kscan {
    // (0,0 is macro num, i.e. top left.
    row-gpios
        = <&pro_micro 2 (GPIO_ACTIVE_HIGH | GPIO_PULL_DOWN)> // num
        , <&pro_micro 6 (GPIO_ACTIVE_HIGH | GPIO_PULL_DOWN)> // top
        , <&pro_micro 5 (GPIO_ACTIVE_HIGH | GPIO_PULL_DOWN)> // home
        , <&pro_micro 4 (GPIO_ACTIVE_HIGH | GPIO_PULL_DOWN)> // bottom
        , <&pro_micro 3 (GPIO_ACTIVE_HIGH | GPIO_PULL_DOWN)> // space
        ;
    col-gpios
        , <&pro_micro 19 GPIO_ACTIVE_HIGH> // macro
        , <&pro_micro 18 GPIO_ACTIVE_HIGH> // outer
        , <&pro_micro 15 GPIO_ACTIVE_HIGH> // pinky
        , <&pro_micro 14 GPIO_ACTIVE_HIGH> // ring
        , <&pro_micro 16 GPIO_ACTIVE_HIGH> // middle
        , <&pro_micro 10 GPIO_ACTIVE_HIGH> // index
        = <&pro_micro 21 GPIO_ACTIVE_HIGH> // inner
        ;
};
